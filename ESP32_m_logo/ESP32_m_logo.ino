/**************************************************************************
 This is an example for our Monochrome OLEDs based on SSD1306 drivers

 Pick one up today in the adafruit shop!
 ------> http://www.adafruit.com/category/63_98

 This example is for a 128x64 pixel display using SPI to communicate
 4 or 5 pins are required to interface.

 Adafruit invests time and resources providing this open
 source code, please support Adafruit and open-source
 hardware by purchasing products from Adafruit!

 Written by Limor Fried/Ladyada for Adafruit Industries,
 with contributions from the open source community.
 BSD license, check license.txt for more information
 All text above, and the splash screen below must be
 included in any redistribution.
 **************************************************************************/

#include <SPI.h>
#include <Wire.h>
#include <Adafruit_GFX.h>
#include <Adafruit_SSD1306.h>
#include <ESP32CAN.h>
#include <CAN_config.h>

#define SCREEN_WIDTH 128 // OLED display width, in pixels
#define SCREEN_HEIGHT 64 // OLED display height, in pixels

// Declaration for SSD1306 display connected using software SPI (default case):
#define OLED_MOSI  23
#define OLED_CLK   18
#define OLED_DC    16
#define OLED_CS    5
#define OLED_RESET 17
Adafruit_SSD1306 display(SCREEN_WIDTH, SCREEN_HEIGHT,
  OLED_MOSI, OLED_CLK, OLED_DC, OLED_RESET, OLED_CS);

const unsigned char M_logo [] PROGMEM = {
  //94x32 ///MLogo
  0xff, 0xff, 0xff, 0xff, 0xff, 0xff, 0xff, 0xff, 0xff, 0xff, 0xff, 0xfc, 0xff, 0xff, 0xf0, 0x00, 
  0xc0, 0x03, 0x00, 0x06, 0x00, 0x0f, 0xe0, 0x04, 0xff, 0xff, 0xe0, 0x00, 0x80, 0x03, 0x00, 0x0e, 
  0x00, 0x0f, 0xc0, 0x04, 0xff, 0xff, 0xc0, 0x01, 0x80, 0x06, 0x00, 0x0c, 0x00, 0x0f, 0x80, 0x04, 
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  0xc0, 0x1f, 0xe0, 0x04, 0xff, 0xff, 0xff, 0xff, 0xff, 0xff, 0xff, 0xff, 0xff, 0xff, 0xff, 0xfc
};

//Init can device
CAN_device_t CAN_cfg;


void setup() {
  Serial.begin(115200);   // Might need to go higher...

  // Init CAN Bus
  CAN_cfg.speed=CAN_SPEED_100KBPS; // BMW Kcan runs at 100kbps
  CAN_cfg.tx_pin_id = GPIO_NUM_4;
  CAN_cfg.rx_pin_id = GPIO_NUM_2;
  CAN_cfg.rx_queue = xQueueCreate(10,sizeof(CAN_frame_t));
  //initialize CAN Module
  ESP32Can.CANInit();

  // Init display
  if(!display.begin(SSD1306_SWITCHCAPVCC, 0x3C)) { // Address 0x3D for 128x64
    Serial.println(F("SSD1306 allocation failed"));
    for(;;);
  }

  delay(1000);
  display.clearDisplay();

}
void loop() {

    CAN_frame_t rx_frame;
    //receive next CAN frame from queue
    if(xQueueReceive(CAN_cfg.rx_queue,&rx_frame, 3*portTICK_PERIOD_MS)==pdTRUE){

      //do stuff!
      if(rx_frame.FIR.B.FF==CAN_frame_std)
        printf("New standard frame");
      else
        printf("New extended frame");

      if(rx_frame.FIR.B.RTR==CAN_RTR)
        printf(" RTR from 0x%08x, DLC %d\r\n",rx_frame.MsgID,  rx_frame.FIR.B.DLC);
      else{
        printf(" from 0x%08x, DLC %d\n",rx_frame.MsgID,  rx_frame.FIR.B.DLC);
        /* convert to upper case and respond to sender */
        for(int i = 0; i < 8; i++){
          if(rx_frame.data.u8[i] >= 'a' && rx_frame.data.u8[i] <= 'z'){
            rx_frame.data.u8[i] = rx_frame.data.u8[i] - 32;
          }
        }
      }
      //respond to sender
      ESP32Can.CANWriteFrame(&rx_frame);
    }

  
  display.clearDisplay();

  //Intro Animation
  display.drawBitmap(0, 12, M_logo, 94, 32, 1);
  display.display(); 
  display.startscrollright(0x00, 0x0F);
  delay(2000);
  display.stopscroll();
  display.clearDisplay();

  // Menu 1
  display.setTextSize(2);
  display.setTextColor(WHITE);
  display.setCursor(0, 0);
  // Display static text
  display.print("BOOST:");
  display.println("14");
  display.println("TEMP:");
  display.display(); 

  delay(2000);
  display.clearDisplay();


  // Menu 2
  display.setTextSize(2);
  display.setTextColor(WHITE);
  display.setCursor(0, 0);
  // Display static text
  display.println("RPM:");
  display.println("");
  display.println("SPEED:");
  display.display(); 

  delay(2000);
  display.clearDisplay();

  // Menu 3
  display.setTextSize(2);
  display.setTextColor(WHITE);
  display.setCursor(0, 0);
  // Display static text
  display.println("TORQUE:");
  display.println("");
  display.println("HRSPWR:");
  display.display(); 

  delay(2000);
  display.clearDisplay();

  // Menu 4
  display.drawBitmap(18, 12, M_logo, 94, 32, 1);
  display.display(); 
  
}
